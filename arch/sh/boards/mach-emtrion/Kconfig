## arch/sh/boards/mach-emtrion/Kconfig
```kconfig
config BUSY_LEDS
	bool "Busy LEDs"
	depends on SH_EMTRION_FEATURES
        default y
	help
                Enabling this will show the kernel busy status on the
                two coloured leds off the core module. Red is set when
                interrupt are serviced and green is lit when processor
                is not idle

config DIRECTFB_CMDLINE
	bool "Provide directfb= command line option for hardware acceleration"
	depends on SH_EMTRION_FEATURES
        default y
	help
                Setting the kernel command line option directfb=hw will
                reserve the last 8MB of RAM for directfb hardware acceleration,
                similar to mem=120M.
                Userspace might use this command line option for further configuration.

config SH_EARLY_SD_FIRMWARE
       bool "Check for SD firmware provided by bootloader"
       depends on MMC_SH_SDHI
       default y
       help
                The bootloader can provide the SD firmware image so the kernel can initialize the SD driver when booting. Otherwise the SD driver needs to be compiled as a module and the firmware loaded by the firmware subsystem.

config SH_BOOTLOGO
       bool "Keep the bootlogo provided by bootloader"
       depends on SH_EMTRION_FEATURES
       default y
       help
                When the bootloader has already configured the display controller, linux will keep it instead of displaying the pinguin. Can be disabled with bootlogo=off and enabled with bootlogo="keep". The framebuffer console will be disabled.

config SH_BOOTLOGO_OVERLAY_WITH_LINUX
       bool "Display an overlay linux/pinguin logo on the bootlogo"
       depends on SH_BOOTLOGO
       default y
       help
                The default linux logo is displayed on the bootlogo of the bootloader. This might be useful only on starterkits and demo boards.

config FAN
	bool "permanent Fan"
	depends on SH_EMTRION_FEATURES
        default y
	help
                Enabling this will permanently enable the FPM fan. 

source "drivers/misc/emtrion/Kconfig"
```

## arch/sh/drivers/Kconfig
```kconfig
source "arch/sh/drivers/dma/Kconfig"
source "arch/sh/cchips/Kconfig"

menu "Additional SuperH Device Drivers"

config HEARTBEAT
	bool "Heartbeat LED"
	help
	  Use the power-on LED on your machine as a load meter.  The exact
	  behavior is platform-dependent, but normally the flash frequency is
	  a hyperbolic function of the 5-minute load average.

config PUSH_SWITCH
	tristate "Push switch support"
	help
	  This enables support for the push switch framework, a simple
	  framework that allows for sysfs driven switch status reporting.

config SH_PWM_TPU
	bool "PWM with Timer Pulse Unit (TPU) Driver"
	depends on CPU_SUBTYPE_SH7723
	select HAVE_PWM
        help
          Provides a PWM driver using the Timer Pulse Unit of the SH7723

config GPIO_PRINT_ENUM
        bool "Provides enum names for gpios in debugfs/gpio_print_enum"
	depends on ARCH_REQUIRE_GPIOLIB && DEBUG_FS && CPU_SUBTYPE_SH7723
        help
          For using /sys/class/gpio/export in userspace, the GPIO numbers needs to be known. But in the hardware reference manual, only names (e.g. PTA7) are used. When enabled, the enum names from arch/sh/kernel/cpu/sh4a/pinmux* are reported. These enum contain the pin number used in hardware reference manual.

config I2C_GPIO_SH
	tristate "GPIO-based bitbanging I2C improved for SH"
	depends on CPU_SUBTYPE_SH7723 && GENERIC_GPIO
	select I2C_ALGOBIT
	help
          This is a performance improved bitbanging driver to reduce CPU
	  load and improve I2C transfer rate.

endmenu
```

## drivers/hach-lange/Kconfig
```kconfig
#
# hach-lange driver configuration
#

menuconfig HL_DRIVERS
	boolean "Hach Lange drivers support"
	---help---
	Hach-Lange specific linux drivers are supported here.

if HL_DRIVERS
config RL78_SUPPORT
	tristate "RL78 support setup"
	default y
	help
      This control enables/disables the request handler for the
      connected RL78 sub processors.
      Each RL78 handles up to 3 probes which are connected with the
      sub processor via Modbus. Each RL78 uses a seperate request line
      and a common interrupt (IRQ2) to notify the SH4 master of events.

      If you want RL78 support, you should say Y here.

      This RL78 support can also be built as a module.

config HLIRQ_SUPPORT
	boolean "HL-IRQ support setup"
	default n
	help
	  Enable HL IRQ interrupt support.
	  This control enables/disables support for the HL-IRQ functionality.
	  It is not allowed to enable both the RL78_SUPPORT and HLIRQ_SUPPORT
	  at the same time since they share IRQ2.

config FUSIONBOARD_SUPPORT
	boolean "Hach-Lange Fusion board"
	default y
	help
	  This control enables/disables support for the following hardware
	  extras on the Fusion Board:
	  1.) Check if left button was pushed during booting of linux.
	  2.) Set and query status for both fans
	  3.) Set and query LED status (red/green/off).
	  All features are accessible from the /sys directory tree.
	  If you want Hach-Lange Fusion board support, you should say Y here.

endif
```

## drivers/hach-lange/RL78_I2C/Kconfig
```kconfig
#
# RL78 driver configuration subsystem configuration
#

menuconfig RL78
    bool "RL78 support"
    ---help---
      This driver implements the request handler for the connected RL78 sub processors.
      Each RL78 handles up to 3 probes which are connected with the sub processor via Modbus.
      Each RL78 uses a seperate request line and a common interrupt (IRQ2) to notify the SH4 master of events.

      If you want RL78 support, you should say Y here.

      This RL78 support can also be built as a module.
```

## drivers/misc/emtrion/Kconfig
```kconfig
config EM_COMMON
	boolean
	default n

config EM_DEVICE_SETUP
	boolean
	default n

config EM_DIMM_MODULE
	boolean
	default n

config EM_BASEBOARD
	bool "Baseboard support"
	default n
        help
          An emtrion core/cpu module can be installed on a range of baseboards. With this option enabled, the kernel can detect, configured and load drivers depending on the baseboard the core module is installed.

config EM_BASEBOARD_DIMMECOBASE
	bool "Support DIMM-Eco-Base"
	depends on SH_HICO7723 && EM_BASEBOARD && EM_DIMM_MODULE
        default n
	help
	  Enable this if the core module will be used on a DIMM-Eco-Base/HiCO.DIMM-Eco-Base

config EM_BASEBOARD_DIMMBASE
	bool "Support DIMM-Base"
	depends on SH_HICO7723 && EM_BASEBOARD && EM_DIMM_MODULE
        default n
	help
	  Enable this if the core module will be used on a DIMM-Base/HiCO.DIMMBase

config EM_BASEBOARD_PELLENC
	bool "Support Pellenc"
	depends on SH_HICO7723 && EM_BASEBOARD && EM_DIMM_MODULE
        default n
	help
	  Enable this if the core module will be used on a Pellenc

config EM_BASEBOARD_HACHLANGE
	bool "Support HachLange"
	depends on SH_HICO7723 && EM_BASEBOARD && EM_DIMM_MODULE
        default n
	help
	  Enable this if the core module will be used on a Hach-Lange base board

config EM_BASEBOARD_DIMMBASE_LOTHRON
	bool "Support DIMM-Base Lothron"
	depends on SH_HICO7724 && EM_BASEBOARD && EM_DIMM_MODULE
        default n
	help
	  Enable this if the core module will be used on a DIMM-Base Lothron

config EM_FIRMWARE_BY_BOOTLOADER
	bool "Firmware images are given by bootloader"
	depends on FIRMWARE_IN_KERNEL
	default n
	help
	  When it's not possible to link the firmware to the kernel due to licensing, but the use
	  of initrd/initramfs is too complicated/too slow, then the bootloader can give the firmware to linux.
```

## drivers/mmc/core/Kconfig
```kconfig
#
# MMC core configuration
#

config MMC_UNSAFE_RESUME
	bool "Assume MMC/SD cards are non-removable (DANGEROUS)"
	help
	  If you say Y here, the MMC layer will assume that all cards
	  stayed in their respective slots during the suspend. The
	  normal behaviour is to remove them at suspend and
	  redetecting them at resume. Breaking this assumption will
	  in most cases result in data corruption.

	  This option is usually just for embedded systems which use
	  a MMC/SD card for rootfs. Most people should say N here.

	  This option sets a default which can be overridden by the
	  module parameter "removable=0" or "removable=1".


config MMC_ALLOW_ACCESS_TO_FX
        bool "Allow acces to function 0 0xF0...0xFF registers"
        default n
        help
           Some drivers, e.g. CSR1050, need to access the function 0 registers directly
```

## sound/sh/Kconfig
```kconfig
# ALSA SH drivers

menuconfig SND_SUPERH
	bool "SUPERH sound devices"
	depends on SUPERH
	default y
	help
	  Support for sound devices specific to SUPERH architectures.
	  Drivers that are implemented on ASoC can be found in
	  "ALSA for SoC audio support" section.

if SND_SUPERH

config SND_AICA
	tristate "Dreamcast Yamaha AICA sound"
	depends on SH_DREAMCAST
	select SND_PCM
	select G2_DMA
	help
	  ALSA Sound driver for the SEGA Dreamcast console.

config SND_SH_DAC_AUDIO
	tristate "SuperH DAC audio support"
	depends on SND
	depends on CPU_SH3 && HIGH_RES_TIMERS
	select SND_PCM
	help
	  Say Y here to include support for the on-chip DAC.

config SH7343_SIU
	tristate "Renesas SH7343 SIU"
	depends on CPU_SUBTYPE_SH7722 || CPU_SUBTYPE_SH7723
	---help---
	  Say M if you want to use the Sound Interface Unit peripheral
	  on the SH-Mobile processor.
	  You will get a module called siu_sh7343.

	  If you do not want to use the SH-Mobile on board SIU, you can 
	  safely say N here.

choice
	prompt "Codec"
	depends on SH7343_SIU
	default WM8978_CODEC
	help
	  This option determines the codec connected to the SIU or SIOF module 
	  of the SuperH processor.

config WM8750_CODEC
	bool "WM8750 codec (SIU)"
	help
	  If you do not have an WM8750 codec connected to the SH7723 SIU
	  you can safely say N here.
	  
config WM8978_CODEC
	bool "WM8978 codec"
	help
	  If you do not have an WM8978 codec connected to the SIU or the SIOF
	  you can safely say N here.

config AK4537_CODEC
	bool "AK4537 codec (solution engine)"
	help
	  If you do not have an AK4537 codec connected to the SIU or the SIOF
	  you can safely say N here.

config TLV320AIC_CODEC
	bool "TLV320AIC codec (SIU)"
	help
	  If you do not have an TLV320AIC codec connected to the SH7723 SIU
	  you can safely say N here.

endchoice

endif	# SND_SUPERH
```
